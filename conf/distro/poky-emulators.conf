## conf/distro/poky-emulators.conf
```bitbake
# Distribution definition for: poky-emulators
#
# Copyright (c) 2014, Embedded Labworks.
# All rights reserved.
#
# This file is released under the MIT license as described in
# COPYING.MIT.
#

require conf/distro/poky.conf

DISTRO = "poky-emulators"

DISTRO_FEATURES_append = " directfb opengl x11 alsa"
```

## conf/layer.conf
```bitbake
# We have a conf and classes directory, add to BBPATH
BBPATH .= ":${LAYERDIR}"

# We have recipes-* directories, add to BBFILES
BBFILES += "${LAYERDIR}/recipes-*/*/*.bb \
            ${LAYERDIR}/recipes-*/*/*.bbappend"

BBFILE_COLLECTIONS += "game-emulators"

BBFILE_PATTERN_game-emulators = "^${LAYERDIR}/"

BBFILE_PRIORITY_game-emulators = "6"

LAYERVERSION_game-emulators = "2"
LAYERDEPENDS_game-emulators = "core openembedded-layer"

LAYERSERIES_COMPAT_game-emulators = " hardknott"

# Additional licenses
LICENSE_PATH += "${LAYERDIR}/licenses"
```
